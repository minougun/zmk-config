#include <input/processors.dtsi>

/ {
  trackball_listener: trackball_listener {
    compatible = "zmk,input-listener";
    device = <&trackball>;
    input-processors = <&zip_temp_layer 3 5000>; // レイヤー5を5秒オン
  };
};

&zip_temp_layer { require-prior-idle-ms = <200>; }
